## CMakeLists.txt
```
# SPDX-License-Identifier: Apache-2.0

cmake_minimum_required(VERSION 3.13.1)

include($ENV{ZEPHYR_BASE}/cmake/app/boilerplate.cmake NO_POLICY_SCOPE)
project(aisgCommands)

FILE(GLOB app_sources src/*.c)
target_sources(app PRIVATE ${app_sources})
include_directories(${CMAKE_SOURCE_DIR}/include)


include_directories(${CMAKE_BINARY_DIR}/generated)
# END Include git info in build
```

## Kconfig
```
source "Kconfig.zephyr"

source "../zephyr_lib/Kconfig"
```

## prj.conf
```kconfig
CONFIG_PINMUX=y
CONFIG_GPIO=y

# PWM
CONFIG_PWM=y
CONFIG_PWM_LOG_LEVEL_DBG=y

# PIEZO
CONFIG_PIEZO=y

# command line shell
CONFIG_SHELL=y
CONFIG_KERNEL_SHELL=y
CONFIG_DEVICE_SHELL=y
CONFIG_INIT_STACKS=y
CONFIG_STACK_SENTINEL=y
CONFIG_THREAD_MONITOR=y
CONFIG_THREAD_NAME=y

# turn on log system
CONFIG_LOG=y
CONFIG_LOG_BACKEND_UART=y
```

## src/main.c
```c
/*
 * Copyright (c) 2020 Laird Connectivity
 */

#include <zephyr.h>
#include <sys/printk.h>
#include <logging/log.h>
#include "version.h"
#include "piezoWorkQueue.h"
#include "piezoThreadExample.h"

void main(void)
{
	printk("Laird Connectivity %s\n", CONFIG_BOARD);
	setup_piezo_work_queue();
	setup_piezo_thread();

	/* The shell runs a loop so don't loop anything here, do it in a thread */
}
```

## include/piezoWorkQueue.h
```c
/*
 * Copyright (c) 2020 Laird Connectivity
 */

#ifndef PIEZO_WORK_QUEUE_H
#define PIEZO_WORK_QUEUE_H

#include <kernel.h>

#ifdef __cplusplus
extern "C" {
#endif

void sample_beep(void);
void setup_piezo_work_queue(void);

#ifdef __cplusplus
}
#endif

#endif /* PIEZO_WORK_QUEUE_H */
```

## src/debugShell.c
```c
/*
 * Copyright (c) 2020 Laird Connectivity
 */

#include <zephyr.h>
#include <sys/printk.h>
#include <shell/shell.h>
#include <shell/shell_uart.h>
#include <logging/log.h>
#include <stdlib.h>
#include "version.h"
#include "piezoWorkQueue.h"
#include "piezoThreadExample.h"

LOG_MODULE_REGISTER(DebugShell);

static int beep_the_piezo(const struct shell *shell, size_t argc, char **argv)
{
	ARG_UNUSED(argc);
	ARG_UNUSED(argv);
	shell_print(shell, "beep piezo");
	sample_beep();
	return 0;
}

static int test_the_piezo(const struct shell *shell, size_t argc, char **argv)
{
	ARG_UNUSED(argc);
	ARG_UNUSED(argv);
	if (is_piezo_running() == true) {
		shell_print(shell, "piezo already running");
	} else {
		shell_print(shell, "starting piezo test");
		test_piezo();
	}
	return 0;
}

static int stop_the_piezo(const struct shell *shell, size_t argc, char **argv)
{
	ARG_UNUSED(argc);
	ARG_UNUSED(argv);
	if (is_piezo_running() == true) {
		shell_print(shell, "stopping the piezo test");
		stop_piezo();
	} else {
		shell_print(shell, "Test not running");
	}
	return 0;
}

SHELL_STATIC_SUBCMD_SET_CREATE(
	sub_piezo, SHELL_CMD(beep, NULL, "beep piezo", beep_the_piezo),
	SHELL_CMD(test, NULL, "test piezo", test_the_piezo),
	SHELL_CMD(stop, NULL, "stop the piezo", stop_the_piezo),
	SHELL_SUBCMD_SET_END);
SHELL_CMD_REGISTER(piezo, &sub_piezo, "piezo", NULL);
```

## src/piezoThreadExample.c
```c
/*
 * Copyright (c) 2020 Laird Connectivity
 */

#include <zephyr.h>
#include <sys/printk.h>
#include <device.h>
#include <logging/log.h>
#include "piezo.h"
#include "piezoWorkQueue.h"
#include "piezoThreadExample.h"

#define LOG_LEVEL LOG_LEVEL_DBG
LOG_MODULE_REGISTER(PiezoThreadExample, LOG_LEVEL);
#define PIEZO_PRIORITY K_PRIO_PREEMPT(5)
#define PIEZO_STACK_LENGTH 512
static K_THREAD_STACK_DEFINE(Piezo_stack_area, PIEZO_STACK_LENGTH);
static struct k_thread Piezo_thread_data;

#define PERIOD_MIN 50
#define PERIOD_MAX 3900
#define PERIOD_INIT 1500
#define BEEP_DURATION K_MSEC(60)
static u32_t Period = PERIOD_INIT;
typedef enum { Test_Piezo, Beep_Piezo } set_piezo_state;
static struct k_sem Piezo_Wait_Sem;
static struct k_sem Piezo_Beep_Sem;
static set_piezo_state State;
struct device *Dev_PWM;
static int Sema_State;
static bool Piezo_Running;

static void wait_for_input(void *unused1, void *unused2, void *unused3)
{
	Piezo_Running = false;
	u8_t dir = 0U;
	k_sem_init(&Piezo_Wait_Sem, 0, 1);
	k_sem_init(&Piezo_Beep_Sem, 0, 1);
	while (true) {
		k_sem_take(&Piezo_Wait_Sem, K_FOREVER);
		switch (State) {
		case Test_Piezo:
			while (1) {
				Piezo_Running = true;
				if (piezo_on(Period, Period / 2) == false) {
					return;
				}
				k_sleep(BEEP_DURATION);
				if (dir) {
					if (Period < PERIOD_MIN) {
						dir = 0U;
					} else {
						Period -= PERIOD_MIN;
					}
				} else {
					Period += PERIOD_MIN;

					if (Period >= PERIOD_MAX) {
						dir = 1U;
						Period = PERIOD_MAX;
					}
				}
				Sema_State = k_sem_take(&Piezo_Beep_Sem,
							K_MSEC(1000));
				if (Sema_State == 0) {
					piezo_off();
					Piezo_Running = false;
					break;
				}
			}
			break;
		default:
			LOG_ERR("erroneous beep state: %d", State);
			break;
		}
	}
}

void test_piezo(void)
{
	State = Test_Piezo;
	k_sem_give(&Piezo_Wait_Sem);
}

void stop_piezo(void)
{
	k_sem_give(&Piezo_Beep_Sem);
}

bool is_piezo_running(void)
{
	return Piezo_Running;
}

void setup_piezo_thread(void)
{
	k_thread_create(&Piezo_thread_data, Piezo_stack_area,
			K_THREAD_STACK_SIZEOF(Piezo_stack_area), wait_for_input,
			NULL, NULL, NULL, PIEZO_PRIORITY, 0, K_NO_WAIT);
	k_thread_name_set(&Piezo_thread_data, "piezo");
}
```

## src/piezoWorkQueue.c
```c
/*
 * Copyright (c) 2020 Laird Connectivity
 */

#include <zephyr.h>
#include <sys/printk.h>
#include <device.h>
#include "piezo.h"
#include <logging/log.h>
#include "piezoWorkQueue.h"

#define LOG_LEVEL LOG_LEVEL_DBG
LOG_MODULE_REGISTER(PiezoWorkQueue, LOG_LEVEL);
#define PIEZO_STACK_SIZE 512
#define PIEZO_PRIORITY K_PRIO_PREEMPT(4)
static K_THREAD_STACK_DEFINE(Piezo_stack_area, PIEZO_STACK_SIZE);
static struct k_work_q Piezo_work_q;
static struct k_delayed_work Piezo_work;

#define BEEP_PERIOD 1500
#define BEEP_DUTY_CYCLE (1500 / 2U)
#define BEEP_DURATION K_MSEC(500)
void sample_beep(void)
{
	piezo_on(BEEP_PERIOD, BEEP_DUTY_CYCLE);
	k_delayed_work_submit(&Piezo_work, BEEP_DURATION);
}

void piezo_stop_work_queue(struct k_work *item)
{
	piezo_off();
}

void setup_piezo_work_queue(void)
{
	k_work_q_start(&Piezo_work_q, Piezo_stack_area,
		       K_THREAD_STACK_SIZEOF(Piezo_stack_area), PIEZO_PRIORITY);
	k_delayed_work_init(&Piezo_work, piezo_stop_work_queue);
}
```
