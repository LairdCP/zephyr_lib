## prj.conf
```kconfig
CONFIG_PINMUX=y
CONFIG_GPIO=y

# PWM
CONFIG_PWM=y
CONFIG_PWM_LOG_LEVEL_DBG=y

# PIEZO
CONFIG_PIEZO=y

# VIBEMOTOR
CONFIG_VIBEMOTOR=y

# command line shell
CONFIG_SHELL=y
CONFIG_KERNEL_SHELL=y
CONFIG_DEVICE_SHELL=y
CONFIG_INIT_STACKS=y
CONFIG_STACK_SENTINEL=y
CONFIG_THREAD_MONITOR=y
CONFIG_THREAD_NAME=y

# turn on log system
CONFIG_LOG=y
CONFIG_LOG_BACKEND_UART=y
```

## src/main.c
```c
/*
 * Copyright (c) 2020 Laird Connectivity
 */

#include <zephyr.h>
#include <sys/printk.h>
#include <logging/log.h>
#include "version.h"
#include "workQueue.h"
#include "piezoThreadExample.h"
#include "vibeThreadExample.h"

void main(void)
{
	printk("Laird Connectivity %s\n", CONFIG_BOARD);
	setup_work_queue();
	setup_piezo_thread();
	setup_vibe_thread();

	/* The shell runs a loop so don't loop anything here, do it in a thread */
}
```

## include/accelSample.h
```c
/*
 * Copyright (c) 2020 Laird Connectivity
 */

#ifndef ACCEL_SAMPLE_H
#define ACCEL_SAMPLE_H

#include <kernel.h>

#ifdef __cplusplus
extern "C" {
#endif

void sample_accel(void);

#ifdef __cplusplus
}
#endif

#endif /* ACCEL_SAMPLE_H */
```

## include/piezoSample.h
```c
/*
 * Copyright (c) 2020 Laird Connectivity
 */

#ifndef PIEZO_SAMPLE_H
#define PIEZO_SAMPLE_H

#include <kernel.h>

#ifdef __cplusplus
extern "C" {
#endif

void sample_beep(void);

#ifdef __cplusplus
}
#endif

#endif /* PIEZO_SAMPLE_H */
```

## include/piezoThreadExample.h
```c
/*
 * Copyright (c) 2020 Laird Connectivity
 */

#ifndef PIEZO_THREAD_EXAMPLE_H
#define PIEZO_THREAD_EXAMPLE_H

#include <kernel.h>

#ifdef __cplusplus
extern "C" {
#endif

void test_piezo(void);
void stop_piezo(void);
bool is_piezo_running(void);
void setup_piezo_thread(void);

#ifdef __cplusplus
}
#endif

#endif /* PIEZO_THREAD_EXAMPLE_H */
```

## include/vibeSample.h
```c
/*
 * Copyright (c) 2020 Laird Connectivity
 */

#ifndef VIBE_SAMPLE_H
#define VIBE_SAMPLE_H

#include <kernel.h>

#ifdef __cplusplus
extern "C" {
#endif

void sample_vibrate(void);

#ifdef __cplusplus
}
#endif

#endif /* VIBE_SAMPLE_H */
```

## include/vibeThreadExample.h
```c
/*
 * Copyright (c) 2020 Laird Connectivity
 */

#ifndef VIBE_THREAD_EXAMPLE_H
#define VIBE_THREAD_EXAMPLE_H

#include <kernel.h>

#ifdef __cplusplus
extern "C" {
#endif

void test_vibe(void);
void stop_vibe(void);
bool is_vibe_running(void);
void setup_vibe_thread(void);

#ifdef __cplusplus
}
#endif

#endif /* VIBE_THREAD_EXAMPLE_H */
```

## include/workQueue.h
```c
/*
 * Copyright (c) 2020 Laird Connectivity
 */

#ifndef WORK_QUEUE_H
#define WORK_QUEUE_H

#include <kernel.h>

#ifdef __cplusplus
extern "C" {
#endif

struct sensor_info {
	struct k_delayed_work piezo_work;
	struct k_delayed_work vibe_work;
	bool piezo_running;
	bool vibe_running;
};

extern struct sensor_info Sensor_work_status;

void setup_work_queue(void);

#ifdef __cplusplus
}
#endif

#endif /* WORK_QUEUE_H */
```

## src/debugShell.c
```c
/*
 * Copyright (c) 2020 Laird Connectivity
 */

#include <zephyr.h>
#include <sys/printk.h>
#include <shell/shell.h>
#include <shell/shell_uart.h>
#include <logging/log.h>
#include <stdlib.h>
#include "version.h"
#include "piezoSample.h"
#include "piezoThreadExample.h"
#include "vibeSample.h"
#include "vibeThreadExample.h"
#include "LedPwm.h"

LOG_MODULE_REGISTER(DebugShell);

static int beep_the_piezo(const struct shell *shell, size_t argc, char **argv)
{
	ARG_UNUSED(argc);
	ARG_UNUSED(argv);
	shell_print(shell, "beep piezo");
	sample_beep();
	return 0;
}

static int test_the_piezo(const struct shell *shell, size_t argc, char **argv)
{
	ARG_UNUSED(argc);
	ARG_UNUSED(argv);
	if (is_piezo_running() == true) {
		shell_print(shell, "piezo already running");
	} else {
		shell_print(shell, "starting piezo test");
		test_piezo();
	}
	return 0;
}

static int stop_the_piezo(const struct shell *shell, size_t argc, char **argv)
{
	ARG_UNUSED(argc);
	ARG_UNUSED(argv);
	if (is_piezo_running() == true) {
		shell_print(shell, "stopping the piezo test");
		stop_piezo();
	} else {
		shell_print(shell, "Test not running");
	}
	return 0;
}

static int vibrate(const struct shell *shell, size_t argc, char **argv)
{
	ARG_UNUSED(argc);
	ARG_UNUSED(argv);
	shell_print(shell, "vibrate");
	sample_vibrate();
	return 0;
}

static int test_vibrate(const struct shell *shell, size_t argc, char **argv)
{
	ARG_UNUSED(argc);
	ARG_UNUSED(argv);
	if (is_vibe_running() == true) {
		shell_print(shell, "vibe already running");
	} else {
		shell_print(shell, "starting vibe test");
		test_vibe();
	}
	return 0;
}

static int stop_vibrate(const struct shell *shell, size_t argc, char **argv)
{
	ARG_UNUSED(argc);
	ARG_UNUSED(argv);
	if (is_vibe_running() == true) {
		shell_print(shell, "stopping the vibe test");
		stop_vibe();
	} else {
		shell_print(shell, "Test not running");
	}
	return 0;
}

static int turn_on_led(const struct shell *shell, size_t argc, char **argv)
{
	if(argc < 5) {
		shell_print(shell, "usage: led on <led_index> <period> <duty_cycle>");
	}
	LedPwm_on(strtoul(argv[2], 10), strtoul(argv[3], 10), strtoul(argv[4], 10));
}

static int turn_off_led(const struct shell *shell, size_t argc, char **argv)
{
	if(argc < 3) {
		shell_print(shell, "usage: led off <led_index>");
	}
	LedPwm_off(strtoul(argv[2], 10));
}

static int turn_on_piezo(const struct shell *shell, size_t argc, char **argv)
{
	if(argc < 4) {
		shell_print(shell, "usage: piezo on <period> <duty_cycle>");
	}
	piezo_on(strtoul(argv[2], 10), strtoul(argv[3], 10));
	return 0;
}

static int turn_off_piezo(const struct shell *shell, size_t argc, char **argv)
{
	ARG_UNUSED(argc);
	ARG_UNUSED(argv);
	piezo_off();
	return 0;
}

static int turn_on_vibe(const struct shell *shell, size_t argc, char **argv)
{
	if(argc < 4) {
		shell_print(shell, "usage: vibe on <period> <duty_cycle>");
	}
	vibe_on(strtoul(argv[2], 10), strtoul(argv[3], 10));
	return 0;
}

static int turn_off_vibe(const struct shell *shell, size_t argc, char **argv)
{
	ARG_UNUSED(argc);
	ARG_UNUSED(argv);
	stop_vibe();
	return 0;
}

SHELL_STATIC_SUBCMD_SET_CREATE(
	sub_play, SHELL_CMD(beep, NULL, "beep piezo", beep_the_piezo),
	SHELL_CMD(testbeeps, NULL, "test piezo", test_the_piezo),
	SHELL_CMD(stopbeeps, NULL, "stop the piezo", stop_the_piezo),
	SHELL_CMD(vibe, NULL, "vibrate", vibrate),
	SHELL_CMD(testvibe, NULL, "test vibe", test_vibrate),
	SHELL_CMD(stopvibe, NULL, "stop the vibe", stop_vibrate),
	SHELL_SUBCMD_SET_END);
SHELL_CMD_REGISTER(play, &sub_play, "play", NULL);
SHELL_STATIC_SUBCMD_SET_CREATE(
	sub_led, SHELL_CMD(on, NULL, "turn on LED at period and duty cycle", turn_on_led),
	SHELL_CMD(off, NULL, "turn off LED", turn_off_led),
	SHELL_SUBCMD_SET_END);
SHELL_CMD_REGISTER(led, &sub_led, "led", NULL);
SHELL_STATIC_SUBCMD_SET_CREATE(
	sub_piezo, SHELL_CMD(on, NULL, "turn on piezo at period and duty cycle", turn_on_piezo),
	SHELL_CMD(off, NULL, "turn off piezo", turn_off_piezo),
	SHELL_SUBCMD_SET_END);
SHELL_CMD_REGISTER(piezo, &sub_piezo, "piezo", NULL);
SHELL_STATIC_SUBCMD_SET_CREATE(
	sub_vibe, SHELL_CMD(on, NULL, "turn on vibe at period and duty cycle", turn_on_vibe),
	SHELL_CMD(off, NULL, "turn off vibe", turn_off_vibe),
	SHELL_SUBCMD_SET_END);
SHELL_CMD_REGISTER(vibe, &sub_vibe, "vibe", NULL);
```

## src/piezoSample.c
```c
/*
 * Copyright (c) 2020 Laird Connectivity
 */

#include <zephyr.h>
#include <sys/printk.h>
#include <logging/log.h>
#include <device.h>
#include "piezo.h"
#include "piezoSample.h"
#include "workQueue.h"

#define LOG_LEVEL LOG_LEVEL_DBG
LOG_MODULE_REGISTER(piezoSample, LOG_LEVEL);

#define BEEP_PERIOD 1500
#define BEEP_DUTY_CYCLE (1500 / 2U)
#define BEEP_DURATION K_MSEC(500)
void sample_beep(void)
{
	piezo_on(BEEP_PERIOD, BEEP_DUTY_CYCLE);
	Sensor_work_status.piezo_running = true;
	k_delayed_work_submit(&Sensor_work_status.piezo_work, BEEP_DURATION);
}
```

## src/piezoThreadExample.c
```c
/*
 * Copyright (c) 2020 Laird Connectivity
 */

#include <zephyr.h>
#include <sys/printk.h>
#include <device.h>
#include <logging/log.h>
#include "piezo.h"
#include "WorkQueue.h"
#include "piezoThreadExample.h"

#define LOG_LEVEL LOG_LEVEL_DBG
LOG_MODULE_REGISTER(piezoThreadExample, LOG_LEVEL);
#define PIEZO_PRIORITY K_PRIO_PREEMPT(5)
#define PIEZO_STACK_LENGTH 512
static K_THREAD_STACK_DEFINE(Piezo_stack_area, PIEZO_STACK_LENGTH);
static struct k_thread Piezo_thread_data;

#define PERIOD_MIN 50
#define PERIOD_MAX 3900
#define PERIOD_INIT 1500
#define BEEP_DURATION K_MSEC(60)
static uint32_t Period = PERIOD_INIT;
typedef enum { Test_Piezo, Beep_Piezo } set_piezo_state;
static struct k_sem Piezo_Wait_Sem;
static struct k_sem Piezo_Beep_Sem;
static set_piezo_state State;
static int Sema_State;
static bool Piezo_Running;

static void wait_for_input(void *unused1, void *unused2, void *unused3)
{
	Piezo_Running = false;
	uint8_t dir = 0U;
	k_sem_init(&Piezo_Wait_Sem, 0, 1);
	k_sem_init(&Piezo_Beep_Sem, 0, 1);
	while (true) {
		k_sem_take(&Piezo_Wait_Sem, K_FOREVER);
		switch (State) {
		case Test_Piezo:
			while (1) {
				Piezo_Running = true;
				if (piezo_on(Period, Period / 2) == false) {
					return;
				}
				k_sleep(BEEP_DURATION);
				if (dir) {
					if (Period < PERIOD_MIN) {
						dir = 0U;
					} else {
						Period -= PERIOD_MIN;
					}
				} else {
					Period += PERIOD_MIN;

					if (Period >= PERIOD_MAX) {
						dir = 1U;
						Period = PERIOD_MAX;
					}
				}
				Sema_State = k_sem_take(&Piezo_Beep_Sem,
							K_MSEC(1000));
				if (Sema_State == 0) {
					piezo_off();
					Piezo_Running = false;
					break;
				}
			}
			break;
		default:
			LOG_ERR("erroneous beep state: %d", State);
			break;
		}
	}
}

void test_piezo(void)
{
	State = Test_Piezo;
	k_sem_give(&Piezo_Wait_Sem);
}

void stop_piezo(void)
{
	k_sem_give(&Piezo_Beep_Sem);
}

bool is_piezo_running(void)
{
	return Piezo_Running;
}

void setup_piezo_thread(void)
{
	k_thread_create(&Piezo_thread_data, Piezo_stack_area,
			K_THREAD_STACK_SIZEOF(Piezo_stack_area), wait_for_input,
			NULL, NULL, NULL, PIEZO_PRIORITY, 0, K_NO_WAIT);
	k_thread_name_set(&Piezo_thread_data, "piezo");
}
```

## src/vibeSample.c
```c
/*
 * Copyright (c) 2020 Laird Connectivity
 */

#include <zephyr.h>
#include <sys/printk.h>
#include <device.h>
#include <logging/log.h>
#include "vibe.h"
#include "vibeSample.h"
#include "workQueue.h"

#define LOG_LEVEL LOG_LEVEL_DBG
LOG_MODULE_REGISTER(vibeSample, LOG_LEVEL);

#define VIBE_PERIOD 100000
#define VIBE_DUTY_CYCLE (VIBE_PERIOD / 2U)
#define VIBE_DURATION K_MSEC(500)
void sample_vibrate(void)
{
	vibe_on(VIBE_PERIOD, VIBE_DUTY_CYCLE);
	Sensor_work_status.vibe_running = true;
	k_delayed_work_submit(&Sensor_work_status.vibe_work, VIBE_DURATION);
}
```

## src/vibeThreadExample.c
```c
/*
 * Copyright (c) 2020 Laird Connectivity
 */

#include <zephyr.h>
#include <sys/printk.h>
#include <device.h>
#include <logging/log.h>
#include "vibe.h"
#include "WorkQueue.h"
#include "vibeThreadExample.h"

#define LOG_LEVEL LOG_LEVEL_DBG
LOG_MODULE_REGISTER(vibeThreadExample, LOG_LEVEL);
#define VIBE_PRIORITY K_PRIO_PREEMPT(6)
#define VIBE_STACK_LENGTH 512
static K_THREAD_STACK_DEFINE(Vibe_stack_area, VIBE_STACK_LENGTH);
static struct k_thread Vibe_thread_data;

#define PERIOD_MIN 50000
#define PERIOD_MAX 200000
#define PERIOD_INIT 100000
#define VIBE_DURATION K_MSEC(500)
static uint32_t Period = PERIOD_INIT;
typedef enum { Test_Vibe } set_vibe_state;
static struct k_sem Vibe_Wait_Sem;
static struct k_sem Vibe_Beep_Sem;
static set_vibe_state State;
static int Sema_State;
static bool Vibe_Running;

static void wait_for_input(void *unused1, void *unused2, void *unused3)
{
	Vibe_Running = false;
	uint8_t dir = 0U;
	k_sem_init(&Vibe_Wait_Sem, 0, 1);
	k_sem_init(&Vibe_Beep_Sem, 0, 1);
	while (true) {
		k_sem_take(&Vibe_Wait_Sem, K_FOREVER);
		switch (State) {
		case Test_Vibe:
			while (1) {
				Vibe_Running = true;
				if (vibe_on(Period, Period / 2) == false) {
					return;
				}
				k_sleep(VIBE_DURATION);
				if (dir) {
					if (Period < PERIOD_MIN) {
						dir = 0U;
					} else {
						Period -= PERIOD_MIN;
					}
				} else {
					Period += PERIOD_MIN;

					if (Period >= PERIOD_MAX) {
						dir = 1U;
						Period = PERIOD_MAX;
					}
				}
				Sema_State = k_sem_take(&Vibe_Beep_Sem,
							K_MSEC(1000));
				if (Sema_State == 0) {
					vibe_off();
					Vibe_Running = false;
					break;
				}
			}
			break;
		default:
			LOG_ERR("erroneous beep state: %d", State);
			break;
		}
	}
}

void test_vibe(void)
{
	State = Test_Vibe;
	k_sem_give(&Vibe_Wait_Sem);
}

void stop_vibe(void)
{
	k_sem_give(&Vibe_Beep_Sem);
}

bool is_vibe_running(void)
{
	return Vibe_Running;
}

void setup_vibe_thread(void)
{
	k_thread_create(&Vibe_thread_data, Vibe_stack_area,
			K_THREAD_STACK_SIZEOF(Vibe_stack_area), wait_for_input,
			NULL, NULL, NULL, VIBE_PRIORITY, 0, K_NO_WAIT);
	k_thread_name_set(&Vibe_thread_data, "vibe");
}
```

## src/workQueue.c
```c
/*
 * Copyright (c) 2020 Laird Connectivity
 */

#include <zephyr.h>
#include <sys/printk.h>
#include <device.h>
#include <logging/log.h>
#include "workQueue.h"
#include "piezo.h"
#include "vibe.h"

#define LOG_LEVEL LOG_LEVEL_DBG
LOG_MODULE_REGISTER(workQueue, LOG_LEVEL);
struct sensor_info Sensor_work_status;

static void sample_stop_piezo(struct k_work *item)
{
	piezo_off();
}

static void sample_stop_vibe(struct k_work *item)
{
	vibe_off();
}

void setup_work_queue(void)
{
	k_delayed_work_init(&Sensor_work_status.piezo_work, sample_stop_piezo);
	k_delayed_work_init(&Sensor_work_status.vibe_work, sample_stop_vibe);
}
```
