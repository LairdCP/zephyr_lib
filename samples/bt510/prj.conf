## CMakeLists.txt
```
# SPDX-License-Identifier: Apache-2.0

cmake_minimum_required(VERSION 3.13.1)

include($ENV{ZEPHYR_BASE}/cmake/app/boilerplate.cmake NO_POLICY_SCOPE)
project(bt510)

FILE(GLOB app_sources src/*.c)
target_sources(app PRIVATE ${app_sources})
include_directories(${CMAKE_SOURCE_DIR}/include)


include_directories(${CMAKE_BINARY_DIR}/generated)
# END Include git info in build
```

## prj.conf
```kconfig
CONFIG_PINMUX=y
CONFIG_GPIO=y

# LIS2DH Accel Sensor
CONFIG_ACCELEROMETER=y

# command line shell
CONFIG_SHELL=y
CONFIG_KERNEL_SHELL=y
CONFIG_DEVICE_SHELL=y
CONFIG_INIT_STACKS=y
CONFIG_STACK_SENTINEL=y
CONFIG_THREAD_MONITOR=y
CONFIG_THREAD_NAME=y

# turn on log system
CONFIG_LOG=y
CONFIG_LOG_BACKEND_UART=y
```

## src/main.c
```c
/*
 * Copyright (c) 2020 Laird Connectivity
 */

#include <zephyr.h>
#include <sys/printk.h>
#include <logging/log.h>
#include "version.h"
#include "accelerometer.h"

#define SLOPE_THRESHOLD 12  // m/s^2
#define SLOPE_DURATION 6
void main(void)
{
	printk("Laird Connectivity %s\n", CONFIG_BOARD);
	config_accelerometer(LIS2DH_ACCEL_RANGE_8G, LIS2DH_ODR_5_100Hz, SLOPE_THRESHOLD, SLOPE_DURATION);
	/* The shell runs a loop so don't loop anything here, do it in a thread */
}
```

## src/accelSample.c
```c
/*
 * Copyright (c) 2020 Laird Connectivity
 */

#include <zephyr.h>
#include <logging/log.h>
#include "accelerometer.h"
#include "accelSample.h"

#define LOG_LEVEL LOG_LEVEL_DBG
LOG_MODULE_REGISTER(accelSample, LOG_LEVEL);
#define SLOPE_THRESHOLD 12 // m/s^2
#define SLOPE_DURATION 6

void sample_accel(void)
{
	config_accelerometer(LIS2DH_ACCEL_RANGE_8G, LIS2DH_ODR_5_100Hz,
			     SLOPE_THRESHOLD, SLOPE_DURATION);
}
```

## src/debugShell.c
```c
/*
 * Copyright (c) 2020 Laird Connectivity
 */

#include <zephyr.h>
#include <sys/printk.h>
#include <shell/shell.h>
#include <shell/shell_uart.h>
#include <logging/log.h>
#include <stdlib.h>
#include "version.h"

LOG_MODULE_REGISTER(DebugShell);

static int reset_the_board(const struct shell *shell, size_t argc, char **argv)
{
	ARG_UNUSED(argc);
	ARG_UNUSED(argv);
	shell_print(shell, "resetting");
	k_sleep(K_MSEC(500));
	NVIC_SystemReset();
	return 0;
}

SHELL_STATIC_SUBCMD_SET_CREATE(
	sub_play, SHELL_CMD(reset, NULL, "reset the board", reset_the_board),
	SHELL_SUBCMD_SET_END);
SHELL_CMD_REGISTER(play, &sub_play, "play", NULL);
```
