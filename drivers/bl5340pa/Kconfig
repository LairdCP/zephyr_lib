## tests/components/lcz_qrtc/basic_api/testcase.yaml
```yaml
tests:
  components.lcz_qrtc.basic_api:
    tags: drivers lcz_qrtc
    harness: ztest
```

## tests/components/lcz_qrtc/errno/testcase.yaml
```yaml
tests:
  components.lcz_qrtc.errno:
    tags: drivers lcz_qrtc
    harness: ztest
```

## tests/components/lcz_qrtc/minimum_epoch/testcase.yaml
```yaml
tests:
  components.lcz_qrtc.minimum_epoch:
    tags: drivers lcz_qrtc
    harness: ztest
```

## tests/components/lcz_qrtc/minimum_epoch_errno/testcase.yaml
```yaml
tests:
  components.lcz_qrtc.minimum_epoch_errno:
    tags: drivers lcz_qrtc
    harness: ztest
```

## tests/components/lcz_qrtc/sync/testcase.yaml
```yaml
tests:
  components.lcz_qrtc.sync:
    tags: drivers lcz_qrtc
    harness: ztest
```

## tests/components/lcz_watchdog/basic_api/testcase.yaml
```yaml
tests:
  components.lcz_watchdog.basic_api:
    tags: drivers wdt lcz_watchdog
    harness: ztest
```

## utilities/Kconfig
```kconfig
#
# Copyright (c) 2020-2022 Laird Connectivity
#
# SPDX-License-Identifier: Apache-2.0
#

menu "Laird Connectivity Zephyr Utilities"
	 default y

config JSON_LOG_ENABLED
	bool "Print JSON strings using printk"
	help
	  JSON strings can be too large for LOG system.

config FILE_SYSTEM_UTILITIES
	bool "Helper functions for using file system"
	depends on FILE_SYSTEM
	depends on HEAP_MEM_POOL_SIZE > 0

if FILE_SYSTEM_UTILITIES

config FSU_LOG_LEVEL
	int "Log level for Parameters Module"
	range 0 4
	default 3

config FSU_HASH
	bool "Enable hash generation functions"
	depends on MBEDTLS

config FSU_HASH_CHUNK_SIZE
	int "Default chunk size for computing hash"
	depends on FSU_HASH
	default 1024
	help
	  Chunk buffer and SHA256 context use heap.

config FSU_CHECKSUM
	bool "Enable CRC32 checksum generation functions"

config FSU_CHECKSUM_CHUNK_SIZE
	int "Default chunk size for computing checksum"
	depends on FSU_CHECKSUM
	default 1024
	help
	  Chunk buffer use heap.

config FSU_LFS_MOUNT
	bool "Configure lfs partition mount"
	select FILE_SYSTEM_LITTLEFS
	help
	  If disabled, then the partition will need to be manually mounted prior
	  to function use by an application or module (or nRF Connect SDK
	  partition manager) instead of calling fsu_lfs_mount().

if FSU_LFS_MOUNT

config FSU_MOUNT_POINT
	string "Default mount point"
	default "/lfs"

endif # FSU_LFS_MOUNT

config FSU_MAX_PATH_SIZE
	int "The maximum size of the file system mount + path"
	default 16
	help
	  This must be large enough for the value of FSU_MOUNT_POINT and the
	  folder name. "/lfs/app" "/lfs/hl7800" "/lfs/logs" "/lfs/certs"

config FSU_MAX_FILE_NAME_SIZE
	int "The maximum size of a file name."
	default 48
	help
	  hl7800: 123.567.9ab.def_123.567.9ab.def.bin (15+1+15+4+1)=36
	  app: 480-00070-R123.567.9ab.def_LTE-M_FOTA.bin (41+1)=42
	  app: 480-00070-R123.567.9ab.def_NB-IoT_FOTA.bin (42+1)=43

config FSU_MAX_VERSION_SIZE
	int "The maximum size of a version string"
	default 16
	help
	  123.567.9ab.def

config FSU_MAX_IMAGE_NAME_SIZE
	int "The maximum size of the image name"
	default 8
	help
	  Examples: app, hl7800

config FSU_MAX_PRODUCT_NAME_SIZE
	int "The maximum size of a product name string"
	default 24
	help
	  Examples: mg100, pinnacle-mg100, pinnacle-100-dvk, BT510

config FSU_SHELL
	bool "Enable the file system utility shell"
	depends on SHELL
	help
	  The built-in file system shell is often sufficient. This shell
	  exposes features like pattern list and delete.

if FSU_SHELL

config FSU_SHELL_ALLOW_CHANGE
	bool "Enable shell write/change functions"
	default y
	help
	  This allows using functions that can change/removes files and/or
	  configuration.

endif # FSU_SHELL

config FSU_REWRITE_SIZE_CHECK
	bool "Enable size check when rewriting a file (truncate)"

endif # FILE_SYSTEM_UTILITIES

config ERRNO_STR
	bool "Enable generation of string representations of errno"

config LCZ_NRF_RESET_REASON
	bool "Enable module that reads/clears nRF5X reset reason"

endmenu
```

## utilities/Kconfig.lcz_snprintk
```kconfig
menuconfig LCZ_SNPRINTK
	bool "Wrap snprintk with log messages"
    help
      Add print statements to an operation
      in which result is often unchecked.
      If there is a heap, allow malloc version.

if LCZ_SNPRINTK

module=SNPRINTK
module-str=SNPRINTK
source "subsys/logging/Kconfig.template.log_config"

endif # LCZ_SNPRINTK
```
