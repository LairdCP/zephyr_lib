## drivers/bl5340pa/Kconfig
```kconfig
# BL5340PA configuration options

# Copyright (c) 2021, Laird Connectivity
# SPDX-License-Identifier: Apache-2.0

menuconfig LCZ_BL5340PA
	bool "BL5340PA"
	select GPIO
	select LCZ_RPMSG
	depends on BOARD_BL5340PA_DVK_CPUNET
	default y
	help
	  Enable module detection for internal or external antenna module
	  variant. This information can be retrieved over RPMSG.

if LCZ_BL5340PA

config LCZ_BL5340PA_LOG_LEVEL
        int "Log level for BL5340PA component"
        range 0 4
        default 3

config LCZ_BL5340PA_ANTENNA_SELECTION
	bool "Allow antenna selection at runtime"
	help
	  Allows changing the antenna selection at runtime to use the internal
	  or external antenna. Note that this is only functional on external
	  module variants as they have 2 antenna ports, internal module
	  variants do not have an external antenna port and so cannot use this
	  functionality. This can be set over RPMSG.

endif # LCZ_BL5340PA
```

## drivers/lcz_nrf_qspi_nor/Kconfig
```kconfig
# LCZ_NRF_QSPI_NOR configuration options

# Copyright (c) 2021, Laird Connectivity
# SPDX-License-Identifier: Apache-2.0

# Copyright (c) 2019, Nordic Semiconductor ASA
# SPDX-License-Identifier: Apache-2.0

menuconfig LCZ_NRF_QSPI_NOR
	bool "QSPI NOR Flash"
	select FLASH_HAS_DRIVER_ENABLED
	select NRFX_QSPI
	select FLASH_JESD216
	depends on HAS_HW_NRF_QSPI
	depends on !NORDIC_QSPI_NOR
	help
	  Enable support for Laird Connectivity modified nrfx QSPI driver with EasyDMA.

if LCZ_NRF_QSPI_NOR

config NORDIC_QSPI_NOR_INIT_PRIORITY
	int
	default 80
	help
	  Device driver initialization priority.

config NORDIC_QSPI_NOR_FLASH_LAYOUT_PAGE_SIZE
	int "Page size to use for FLASH_LAYOUT feature"
	default 65536
	help
	  When CONFIG_FLASH_PAGE_LAYOUT is used this driver will support
	  that API.  By default the page size corresponds to the block
	  size (65536).  Other option include the sector size (4096).

config NORDIC_QSPI_NOR_STACK_WRITE_BUFFER_SIZE
	int "Size of a stack-based buffer to support writes from NVMC"
	default 0
	help
	  The QSPI peripheral uses DMA and cannot write data that is
	  read from the internal flash.  A non-zero value here enables
	  a stack buffer into which data is copied to allow the write
	  to proceed.  Multiple transfers will be initiated if the
	  data is larger than the configured limit.  Must be a
	  multiple of 4.  The feature is disabled when set to 0.

config LCZ_NRF_QSPI_NOR_COOL_DOWN_PERIOD
	int "The number of milliseconds to wait before shutting the QSPI down"
	default 10000
	help
	  The QSPI consumes current when idling with the default driver not
	  supporting any means of switching it off. This time determines when
	  sufficient inactivity has occurred to allow the QSPI to shut down.

endif # LCZ_NRF_QSPI_NOR
```

## drivers/led_pwm/Kconfig
```kconfig
# PWM configuration options

# Copyright (c) Laird Connectivity
# SPDX-License-Identifier: Apache-2.0

menuconfig LED_PWM
	bool "LED PWM"
	help
	  Enable config options for LEDs.

if LED_PWM

rsource "Kconfig.nrfx"

endif # LED_PWM
```

## drivers/led_pwm/Kconfig.nrfx
```kconfig
# Copyright (c) 2020, Laird Connectivity
# SPDX-License-Identifier: Apache-2.0

config LED_PWM_NRFX
	bool "nRF LED PWM nrfx driver"
	default y
	depends on HAS_HW_NRF_PWM0 || HAS_HW_NRF_PWM1 || \
		   HAS_HW_NRF_PWM2 || HAS_HW_NRF_PWM3
	help
	  Enable support for nrfx Hardware LED PWM for nRF52 MCU series.
```

## drivers/mg100_lis2dh/Kconfig
```kconfig
# LIS3DH Three Axis Accelerometer configuration options

# Copyright (c) 2017 Intel Corporation
# Copyright (c) 2020 Laird Connectivity
# SPDX-License-Identifier: Apache-2.0

menuconfig MG100_LIS2DH
	bool "MG100 LIS2DH Three Axis Accelerometer"
	depends on (I2C && HAS_DTS_I2C) || SPI
	help
	  Enable SPI/I2C-based driver for LIS2DH, and LIS3DH,
	  triaxial accelerometer sensors connected to the host via INT1 only.

if MG100_LIS2DH

choice MG100_LIS2DH_TRIGGER_MODE
	prompt "Trigger mode"
	help
	  Specify the type of triggering to be used by the driver.

config MG100_LIS2DH_TRIGGER_NONE
	bool "No trigger"

config MG100_LIS2DH_TRIGGER_GLOBAL_THREAD
	bool "Use global thread"
	depends on GPIO
	select MG100_LIS2DH_TRIGGER

config MG100_LIS2DH_TRIGGER_OWN_THREAD
	bool "Use own thread"
	depends on GPIO
	select MG100_LIS2DH_TRIGGER

endchoice

config MG100_LIS2DH_TRIGGER
	bool

config MG100_LIS2DH_THREAD_PRIORITY
	int "Thread priority"
	depends on MG100_LIS2DH_TRIGGER_OWN_THREAD
	default 10
	help
	  Priority of thread used by the driver to handle interrupts.

config MG100_LIS2DH_THREAD_STACK_SIZE
	int "Thread stack size"
	depends on MG100_LIS2DH_TRIGGER_OWN_THREAD
	default 1024
	help
	  Stack size of thread used by the driver to handle interrupts.

choice
	prompt "Acceleration measurement range"
	default MG100_LIS2DH_ACCEL_RANGE_RUNTIME
	help
	  Initial measurement full scale range for acceleration values.

config MG100_LIS2DH_ACCEL_RANGE_RUNTIME
	bool "Set at runtime"

config MG100_LIS2DH_ACCEL_RANGE_2G
	bool "+/-2g"

config MG100_LIS2DH_ACCEL_RANGE_4G
	bool "+/-4g"

config MG100_LIS2DH_ACCEL_RANGE_8G
	bool "+/-8g"

config MG100_LIS2DH_ACCEL_RANGE_16G
	bool "+/-16g"

endchoice

choice
	prompt "Operation mode"
	default MG100_LIS2DH_OPER_MODE_NORMAL
	help
	  Choose between high resolution, normal or low power operation
	  mode for chip at init.

config MG100_LIS2DH_OPER_MODE_HIGH_RES
	bool "high resolution (12 bit)"

config MG100_LIS2DH_OPER_MODE_NORMAL
	bool "normal (10 bit)"

config MG100_LIS2DH_OPER_MODE_LOW_POWER
	bool "low power (8 bit)"

endchoice

choice
	prompt "Output data rate frequency"
	default MG100_LIS2DH_ODR_RUNTIME
	help
	  Initial data rate frequency of acceleration data at initialization.
	  Supported values:
	  1Hz, 10Hz, 25Hz, 50Hz, 100Hz, 200Hz, 400Hz in all power modes
	  1620Hz, 5376Hz in low power mode only
	  1344Hz in normal power mode

config MG100_LIS2DH_ODR_RUNTIME
	bool "Set at runtime"

config MG100_LIS2DH_ODR_1
	bool "1Hz"

config MG100_LIS2DH_ODR_2
	bool "10Hz"

config MG100_LIS2DH_ODR_3
	bool "25Hz"

config MG100_LIS2DH_ODR_4
	bool "50Hz"

config MG100_LIS2DH_ODR_5
	bool "100Hz"

config MG100_LIS2DH_ODR_6
	bool "200Hz"

config MG100_LIS2DH_ODR_7
	bool "400Hz"

config MG100_LIS2DH_ODR_8
	bool "1.6KHz"
	depends on MG100_LIS2DH_OPER_MODE_LOW_POWER

config MG100_LIS2DH_ODR_9_NORMAL
	bool "1.25KHz"
	depends on MG100_LIS2DH_OPER_MODE_NORMAL || MG100_LIS2DH_OPER_MODE_HIGH_RES

config MG100_LIS2DH_ODR_9_LOW
	bool "5KHz"
	depends on MG100_LIS2DH_OPER_MODE_LOW_POWER

endchoice

endif # MG100_LIS3DH
```

## drivers/piezo/Kconfig
```kconfig
# PIEZO configuration options

# Copyright (c) Laird Connectivity
# SPDX-License-Identifier: Apache-2.0

menuconfig PIEZO
	bool "Piezo Drivers"
	help
	  Enable config options for Piezo drivers.

if PIEZO

rsource "Kconfig.nrfx"

endif # PIEZO
```

## drivers/piezo/Kconfig.nrfx
```kconfig
# Copyright (c) 2020, Laird Connectivity
# SPDX-License-Identifier: Apache-2.0

config PIEZO_NRFX
	bool "nRF Piezo nrfx driver"
	default y
	depends on HAS_HW_NRF_PWM0 || HAS_HW_NRF_PWM1 || \
		   HAS_HW_NRF_PWM2 || HAS_HW_NRF_PWM3
	help
	  Enable support for nrfx Hardware Piezo driver for nRF52 MCU series.
```

## drivers/vibemotor/Kconfig
```kconfig
# VIBEMOTOR configuration options

# Copyright (c) Laird Connectivity
# SPDX-License-Identifier: Apache-2.0

menuconfig VIBEMOTOR
	bool "Vibe Motor"
	help
	  Enable config options for vibe motor.

if VIBEMOTOR

rsource "Kconfig.nrfx"

endif # VIBEMOTOR
```

## drivers/vibemotor/Kconfig.nrfx
```kconfig
# Copyright (c) 2020, Laird Connectivity
# SPDX-License-Identifier: Apache-2.0

config VIBEMOTOR_NRFX
	bool "nRF vibe motor nrfx driver"
	default y
	depends on HAS_HW_NRF_PWM0 || HAS_HW_NRF_PWM1 || \
		   HAS_HW_NRF_PWM2 || HAS_HW_NRF_PWM3
	help
	  Enable support for nrfx Hardware vibe motor for nRF52 MCU series.
```

## lcz_kvp/Kconfig
```kconfig
#
# Copyright (c) 2021 Laird Connectivity
#
# SPDX-License-Identifier: Apache-2.0
#

menuconfig LCZ_KVP
	bool "Enable Laird Connectivity Key-Value Pair Module"
	depends on FILE_SYSTEM_UTILITIES
	depends on HEAP_MEM_POOL_SIZE > 0

if LCZ_KVP

config LCZ_KVP_INIT_PRIORITY
	int "Sys init priority (APPLICATION)"
	range 1 99
	default 60
	help
	  Can't be higher than the file system init priority.
	  Using fstab is recommended.

module = LCZ_KVP
module-str = LCZ_KVP
source "subsys/logging/Kconfig.template.log_config"

config LCZ_KVP_LOG_VERBOSE
	bool "Enable verbose debug logging for key-value pair module"
	depends on LCZ_KVP_LOG_LEVEL_DBG

config LCZ_KVP_LOG_HEXDUMP
	bool "Enable hexdump of key-value strings"
	depends on LCZ_KVP_LOG_LEVEL_DBG

endif # LCZ_KVP
```

## mcumgr_cmds/Kconfig
```kconfig
#
# Copyright (c) 2022 Laird Connectivity
#
# SPDX-License-Identifier: Apache-2.0
#

rsource "lcz_fs_mgmt/Kconfig"
```

## mcumgr_cmds/lcz_fs_mgmt/Kconfig
```kconfig
# Copyright Runtime.io 2018. All rights reserved.
# Copyright Nordic Semiconductor ASA 2020. All rights reserved.
# Copyright Laird Connectivity 2021. All rights reserved.
# SPDX-License-Identifier: Apache-2.0

if MCUMGR

menuconfig LCZ_MCUMGR_CMD_FS_MGMT
	bool "Enable Laird Connectivity mcumgr handlers for FS management"
	depends on FILE_SYSTEM
	depends on !MCUMGR_CMD_FS_MGMT
	help
	  Enables Laird Connectivity mcumgr handlers for FS management

if LCZ_MCUMGR_CMD_FS_MGMT

choice LCZ_FS_MGMT_MAX_FILE_SIZE
	prompt "Maximum file size that could be uploaded/downloaded"
	default LCZ_FS_MGMT_MAX_FILE_SIZE_64KB
	help
	  Maximum file size that will be allowed to be downloaded from
	  device.
	  This option decides on number of bytes that are reserved in
	  CBOR frame for storage of offset/size of file downloaded.

config LCZ_FS_MGMT_MAX_FILE_SIZE_64KB
	bool "<= 64KB"
	help
	  Files that have size up to 64KB require 1 to 3 bytes to encode
	  size/offset within CBOR frame with file chunk.

config LCZ_FS_MGMT_MAX_FILE_SIZE_4GB
	bool "<= 4GB"
	help
	  Files that have size up to 4GB require 1 to 5 bytes to encode
	  size/offset within CBOR frame with file chunk.

endchoice

config LCZ_FS_MGMT_MAX_OFFSET_LEN
	int
	default 3 if LCZ_FS_MGMT_MAX_FILE_SIZE_64KB
	default 5 if LCZ_FS_MGMT_MAX_FILE_SIZE_4GB
	help
	  Maximal byte length of encoded offset/size, within transferred
	  CBOR frame containing chunk of downloaded file.
	  This value affects how much of data will fit into download buffer,
	  as it selects sizes of fields within headers.
	  NOTE: This option is hidden intentionally as it is intended
	  to be assigned from limited set of allowed values, depending on
	  the selection made in FS_MGMT_MAX_FILE_SIZE menu.

config LCZ_FS_MGMT_UL_CHUNK_SIZE
	int "Maximum chunk size for file uploads"
	default 512
	help
	  Limits the maximum chunk size for file uploads, in bytes. A buffer of
	  this size gets allocated on the stack during handling of a file upload
	  command.

config LCZ_FS_MGMT_DL_CHUNK_SIZE_LIMIT
	bool "Enable setting custom size of download file chunk"
	help
	  By default file chunk, that will be read off storage and fit into
	  mcumgr frame, is automatically calculated to fit into buffer
	  of size MCUGMR_BUF_SIZE with all headers.
	  Enabling this option allows to set MAXIMUM value that will be
	  allowed for such chunk.
	  Look inside fs_mgmt_config.h for details.

if LCZ_FS_MGMT_DL_CHUNK_SIZE_LIMIT

config LCZ_FS_MGMT_DL_CHUNK_SIZE
	int "Maximum chunk size for file downloads"
	range 65 MCUMGR_BUF_SIZE
	default MCUMGR_BUF_SIZE
	help
	  Sets the MAXIMUM size of chunk which will be rounded down to
	  number of bytes that, with all the required headers, will fit
	  into MCUMGR_BUF_SIZE. This means that actual value might be lower
	  then selected, in which case compiler warning will be issued.
	  Look inside fs_mgmt_config.h for details.
	  Note that header sizes are affected by FS_MGMT_MAX_OFFSET_LEN.

endif

config LCZ_FS_MGMT_PATH_SIZE
	int "Maximum file path length"
	default 64
	help
	  Limits the maximum path length for file operations, in bytes. A
	  buffer of this size gets allocated on the stack during handling of
	  file upload and download commands.

config LCZ_FS_MGMT_APPLICATION_ACCESS_CHECK
	bool "Application-layer access check"
	default y
	help
	  Prevents file access by passing the desired action and filename to the
	  application so it can be approved or declined prior to continuing, the
	  user application can implement an allow or deny list based upon any
	  parameters that are needed (see fs_mgmt_impl_app_access_check() in
	  include/lcz_fs_mgmt/fs_mgmt_impl.h for callback details).

config LCZ_FS_MGMT_INTERCEPT
	bool "Application-layer file upload intercept"
	help
	  Passes control of file upload to the application so it can decide how
	  to proceed in processing the request (see fs_mgmt_impl_app_intercept()
	  in include/lcz_fs_mgmt/fs_mgmt_impl.h for callback details).

config LCZ_FS_MGMT_APPLICATION_REDIRECT
	bool "Application-layer filename redirection"
	help
	  Passes filenames to the application so it can decide if they should be
	  rewritten or used as-is (see fs_mgmt_impl_app_redirect() in
	  include/lcz_fs_mgmt/fs_mgmt_impl.h for callback details).

	  Note: Filenames are passed after the application access check is
	        accepted (if enabled) and must not exceed the maximum path size.

endif # LCZ_MCUMGR_CMD_FS_MGMT

endif # MCUMGR
```

## mcumgr_cmds/lcz_os_mgmt/Kconfig
```kconfig
# Copyright Runtime.io 2018. All rights reserved.
# Copyright Nordic Semiconductor ASA 2020. All rights reserved.
# Copyright Laird Connectivity 2021. All rights reserved.
# SPDX-License-Identifier: Apache-2.0

if MCUMGR

menuconfig LCZ_MCUMGR_CMD_OS_MGMT
	bool "Enable Laird Connectivity mcumgr handlers for OS management"
	select REBOOT
	depends on !MCUMGR_CMD_OS_MGMT
	help
	  Enables Laird Connectivity mcumgr handlers for OS management

if LCZ_MCUMGR_CMD_OS_MGMT

config LCZ_OS_MGMT_RESET_MS
	int "Delay before executing reset command (ms)"
	default 250
	help
	  When a reset command is received, the system waits this many milliseconds
	  before performing the reset.  This delay allows time for the mcumgr
	  response to be delivered.

config LCZ_OS_MGMT_TASKSTAT
	bool "Support for taskstat command"
	default y

config LCZ_OS_MGMT_ECHO
	bool "Support for echo command"
	default y

endif # LCZ_MCUMGR_CMD_OS_MGMT

endif # MCUMGR
```

## mcumgr_wrapper/Kconfig
```kconfig
#
# Copyright (c) 2020 Laird Connectivity
#
# SPDX-License-Identifier: Apache-2.0
#

menuconfig LCZ_MCUMGR_WRAPPER
	bool "Laird Connectivity MCU Manager Wrapper"
	depends on MCUMGR

if LCZ_MCUMGR_WRAPPER

config LCZ_MCUMGR_SIMPLE_BLUETOOTH
	bool "Advertise SMP Service for Firmware Update"
	depends on BT
	help
		This should not be selected if there is already a Bluetooth advertiser in project.

config LCZ_MCUMGR_STATS_TICK_RATE_MS
	int "Timer tick rate for timer_ticks statistic"
	depends on MCUMGR_CMD_STAT_MGMT
	default 0

endif # LCZ_MCUMGR_WRAPPER
```

## memfault/Kconfig
```kconfig
#
# Copyright (c) 2021-2022 Laird Connectivity
#
# SPDX-License-Identifier: Apache-2.0
#

config LCZ_MEMFAULT
    bool "Enable Memfault integration"
	select MEMFAULT

if LCZ_MEMFAULT

module=LCZ_MEMFAULT
module-dep=LOG
module-str=LCZ_MEMFAULT
source "${ZEPHYR_BASE}/subsys/logging/Kconfig.template.log_config"

config LCZ_MEMFAULT_SOFTWARE_TYPE
	string "Software type"
	default "firmware"

config LCZ_MEMFAULT_HTTP_TRANSPORT
	bool "Enable HTTP data transport"
	select MEMFAULT_HTTP_ENABLE

config LCZ_MEMFAULT_MQTT_TRANSPORT
	bool "Enable MQTT data transport"
	depends on MQTT_LIB
	depends on LCZ_MQTT
	depends on ATTR

config LCZ_MEMFAULT_METRICS
	bool "Enable Memfault metrics tracking"
	select MEMFAULT_METRICS

config LCZ_MEMFAULT_FILE
	bool "Enable writing of memfault data to a file"
	depends on FILE_SYSTEM_UTILITIES

config MCUMGR_CMD_MEMFAULT_MGMT
        bool "Enable the memfault MCUMGR interface"
        depends on MCUMGR

config MGMT_GROUP_ID_MEMFAULT
        int "MCU manager group id for memfault management"
        default 66
	depends on MCUMGR_CMD_MEMFAULT_MGMT

endif # LCZ_MEMFAULT
```
