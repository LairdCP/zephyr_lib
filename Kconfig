## components/Kconfig.lcz_params
```kconfig
#
# Copyright (c) 2020 Laird Connectivity
#
# SPDX-License-Identifier: Apache-2.0
#

menuconfig LCZ_PARAMS
    bool "Enable Laird Connectivity Parameters Module"
    depends on FILE_SYSTEM
    depends on FILE_SYSTEM_UTILITIES
    depends on HEAP_MEM_POOL_SIZE > 0

if LCZ_PARAMS

config LCZ_PARAMS_LOG_LEVEL
    int "Log level for Parameters Module"
    range 0 4
    default 3

config LCZ_PARAMS_LOG_VERBOSE
    bool "Enable verbose debug logging for Parameters Module"
    depends on LCZ_PARAMS_LOG_LEVEL = 4

config LCZ_PARAMS_MOUNT_POINT
    string "File system mount point for Laird Connectivity parameters"
    default "/lfs"

config LCZ_PARAMS_PATH
    string "Folder (partial path) for parameters"
    default ""
    help
        The default location for parameters written by the cloud is
        "/lfs/params.txt".

config LCZ_PARAMS_MAX_FILE_LENGTH
    int "Maximum length of the parameter file"
    default 1000
    help
        This should be set by the code generator.

config LCZ_PARAMS_MAX_VALUE_LENGTH
    int "Maximum value of a parameter in hex/string form"
    default 96
    help
        This should be set by the code generator.

config LCZ_PARAMS_SHELL
	bool "Enable parameters shell"

endif # LCZ_PARAMS
```

## components/Kconfig.lcz_power
```kconfig
#
# Copyright (c) 2022 Laird Connectivity
#
# SPDX-License-Identifier: Apache-2.0
#

# Splitting ADC and reset could make dependencies cleaner
# nothing else in zephyr wraps with CONFIG_REBOOT (mcumgr selects it).
config LCZ_POWER
	bool "Controls ADC and reset"
	select ADC
	select NRFX_SAADC
	select ADC_NRFX_SAADC
	select REBOOT

if LCZ_POWER

choice LCZ_POWER_TYPE
	prompt "Power monitoring type"
	default LCZ_POWER_TYPE_EXTERNAL if BOARD_MG100 || BOARD_PINNACLE_100_DVK
	default LCZ_POWER_TYPE_DIRECT if !(BOARD_MG100 && BOARD_PINNACLE_100_DVK)
	help
	  Type of power measurement (board dependent)

config LCZ_POWER_TYPE_DIRECT
	bool "Direct VDD measurement"
	help
	  Measure VDD voltage directly for voltage level determination.

config LCZ_POWER_TYPE_EXTERNAL
	bool "External input (voltage divider)"
	help
	  Measure voltage using external potential divider.

endchoice

config LCZ_POWER_LOG_LEVEL
	int "Log level for power module"
	range 0 4
	default 3

config LCZ_CUSTOM_FATAL_ERROR_HANDLER
	bool "Custom fatal error handler that resets on fatal error"
	depends on !BT_LL_NRFXLIB_DEFAULT

config LCZ_ADC_SAMPLE_PERIOD
	int "Number of seconds in between ADC readings"
	default 15

config LCZ_ADC_ALWAYS_SAMPLING
	bool "Keeps the ADC sampling always active regardless of BLE state"
	default y

config LCZ_POWER_POWER_FAILURE
	bool "Enable power failure comparator feature"
	depends on LCZ_POWER_TYPE_DIRECT

endif # LCZ_POWER
```

## components/Kconfig.lcz_pwm_led
```kconfig
#
# Copyright (c) 2020 Laird Connectivity
#
# SPDX-License-Identifier: Apache-2.0
#

menuconfig LCZ_PWM_LED
    bool "Enable LCZ PWM Led driver"
    depends on PWM

if LCZ_PWM_LED

config LCZ_PWM_LED_PINS
    int "The number of PWM LEDs pins"
    range 1 9
    default 8

config LCZ_PWM_LED_LOG_LEVEL
    int "Log level for PWM LED Module"
    range 0 4
    default 3

endif # LCZ_PWM_LED
```

## components/Kconfig.lcz_qrtc
```kconfig
#
# Copyright (c) 2020-2021 Laird Connectivity
#
# SPDX-License-Identifier: Apache-2.0
#

menuconfig LCZ_QRTC
	bool "Enable the Quasi-RTC component"
	help
	  Uses an offset with uptime to replicate functionality of an RTC

if LCZ_QRTC

config LCZ_QRTC_INIT_PRIORITY
	int "Init priority (POST_KERNEL)"
	range 1 99
	default 99

config LCZ_QRTC_MINIMUM_EPOCH
	int "Minimum value of epoch that is allowed to be set"
	default 0

config LCZ_QRTC_LOG_LEVEL
	int "Log level for QRTC module"
	range 0 4
	default 3

config LCZ_QRTC_SYNC_INTERVAL_SECONDS
	int "Interval between sync attempts"
	default 0
	help
	  Disabled when 0
	  Handler must be defined in application

config LCZ_QRTC_SHELL
	bool "Enable shell commands"
	default n
	depends on SHELL

config LCZ_QRTC_SHELL_ENABLE_WRITE
	bool "Enable QRTC shell write command"
	default y
	depends on LCZ_QRTC_SHELL

config LCZ_QRTC_SHELL_ENABLE_FORMATTED_OUTPUT
	bool "Enable QRTC shell formatted time/date output commands"
	default y
	depends on LCZ_QRTC_SHELL

config LCZ_QRTC_USE_ERRNO
	bool "Enable QRTC errno support"
	depends on ERRNO
	help
	  Will store errors in errno (provided by errno.h) if enabled

endif
```

## components/Kconfig.lcz_ramdisk
```kconfig
#
# Copyright (c) 2022 Laird Connectivity
#
# SPDX-License-Identifier: Apache-2.0
#

menuconfig LCZ_RAMDISK
	bool "RAMDISK"
	depends on FILE_SYSTEM
	depends on LCZ

if LCZ_RAMDISK

config LCZ_RAMDISK_MOUNT_POINT
	string "Default mount point"
	default "/ramfs"

config LCZ_RAMDISK_LFS_MOUNT
	bool "Mount RAMDISK lfs partition at boot"
	select FILE_SYSTEM_LITTLEFS
	help
	  If disabled, then the partition will need to be manually mounted prior
	  to usage of it.

if LCZ_RAMDISK_LFS_MOUNT

config LCZ_RAMDISK_INIT_PRIORITY
        int "RAMDISK init priority (APPLICATION)"
        range 0 99
        default 0

endif # LCZ_RAMDISK_LFS_MOUNT

config LCZ_RAMDISK_LOG_LEVEL
        int "Log level for RAMDISK module"
        range 0 4
        default 3

endif # LCZ_RAMDISK
```

## components/Kconfig.lcz_rpmsg
```kconfig
#
# Copyright (c) 2021 Laird Connectivity
#
# SPDX-License-Identifier: Apache-2.0
#

menuconfig LCZ_RPMSG
	bool "RPMSG send/receive component"
	select RPMSG_SERVICE
	depends on HAS_HW_NRF_IPC
	default y
	help
	  Enable RPMSG (remote procedure message) for cross-core message
	  sending/receiving.

if LCZ_RPMSG

config LCZ_RPMSG_MAX_USERS
        int "Maximum number of users of the RPMSG component"
        range 1 32
        default 2

config LCZ_RPMSG_LOG_LEVEL
        int "Log level for RPMSG component"
        range 0 4
        default 3

config LCZ_RPMSG_MAX_MESSAGE_SIZE
        int "Maximum size of messages that can be sent over RPMSG"
        range 1 256
        default 32

endif # LCZ_RPMSG
```

## components/Kconfig.lcz_settings
```kconfig
#
# Copyright (c) 2020 Laird Connectivity
#
# It is provided "as is", without warranty/guarantee of any kind, express of
# implied, including but not limited to the warranties of merchantability,
# fitness for a particular purpose and non-infringement.
#

menuconfig LCZ_SETTINGS
	bool "Enable Laird Connectivity Settings Module"
	depends on FILE_SYSTEM_UTILITIES

if LCZ_SETTINGS

config LCZ_SETTINGS_LOG_LEVEL
    int "Log Level"
    range 0 4
	default 3

config LCZ_SETTINGS_MOUNT_POINT
	string "File system mount point for Laird Connectivity settings"
	default "/lfs"

config LCZ_SETTINGS_PATH
	string "Path to folder for settings"
	default ""

endif # LCZ_SETTINGS
```

## components/Kconfig.lcz_shell_log
```kconfig
#
# Copyright (c) 2021 Laird Connectivity
#
# SPDX-License-Identifier: Apache-2.0
#

menuconfig MCUMGR_CMD_SHELL_LOG_MGMT
        bool "Enable the shell log MCUMGR interface"
        depends on MCUMGR

config MGMT_GROUP_ID_SHELL_LOG
        int "MCU manager group id for shell log management"
        default 68
	depends on MCUMGR_CMD_SHELL_LOG_MGMT
```

## components/Kconfig.lcz_watchdog
```kconfig
# Copyright (c) 2021 Laird Connectivity
# SPDX-License-Identifier: Apache-2.0

menuconfig LCZ_WDT
    bool "Enable Watchdog timer component"
    imply WATCHDOG
    help
        Enable-to-Disable requires power cycle or watchdog reset.
        Watchdog cannot be stopped once started.
        It can be reconfigured after a reset.
        If a watchdog reset occurs, then it won't cause another
        reset unless it is re-enabled.

if LCZ_WDT

config LCZ_WDT_INIT_PRIORITY
    int "System init priority (Application)"
    default 0

config LCZ_WDT_LOG_LEVEL
    int "Log level for watchdog module"
    range 0 4
    default 3

config LCZ_WDT_TIMEOUT_MILLISECONDS
    int "Rate in milliseconds for watchdog"
    range 4000 1200000 if ZTEST
    range 18000 1200000
    default 600000

config LCZ_WDT_MEMFAULT_PRE_FIRE_MS
    int "The software timer fires before the HW WDT"
    default 8000
    help
        This software timer is used to save a core dump before reset.
        This must be large enough so that the system can reboot and
        feed the watchdog. The memfault software watchdog causes a
        reset assertion. Kernel with HL7800 modem requires 3 seconds
        to boot.

config LCZ_WDT_WORK_QUEUE_STACK_SIZE
    int
    default 320

config LCZ_WDT_TEST
    bool "Force the watchdog to timeout (set during initialisation)"

endif # WDT
```

## drivers/Kconfig
```kconfig
#
# Copyright (c) 2020 Laird Connectivity
#
# SPDX-License-Identifier: Apache-2.0
#

menuconfig LCZ_DRIVER
    bool "Laird Connectivity Zephyr Driver Library"

if LCZ_DRIVER

	rsource "piezo/Kconfig"
	rsource "vibemotor/Kconfig"
	rsource "accelerometer/Kconfig"
	rsource "mg100_lis2dh/Kconfig"
	rsource "lcz_nrf_qspi_nor/Kconfig"

endif # LCZ_DRIVER
```

## drivers/accelerometer/Kconfig
```kconfig
# ACCELEROMETER configuration options

# Copyright (c) Laird Connectivity
# SPDX-License-Identifier: Apache-2.0

menuconfig ACCELEROMETER
	bool "accelerometer"
	help
	  Enable config options for accelerometer.
```
