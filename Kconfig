## Kconfig
```kconfig
#
# Copyright (c) 2020 Laird Connectivity
#
menuconfig LCZ
    bool "Laird Connectivity Zephyr Library"

if LCZ

rsource "drivers/Kconfig"
rsource "ble_common/Kconfig"
rsource "ble_services/Kconfig"
rsource "components/Kconfig"
rsource "utilities/Kconfig"
rsource "mcumgr_wrapper/Kconfig"
rsource "memfault/Kconfig"

endif # LCZ
```

## ble_common/Kconfig
```kconfig
#
# Copyright (c) 2021 Laird Connectivity
#
# SPDX-License-Identifier: Apache-2.0
#

if BT

menu "Laird Connectivity Zephyr BLE Common Components"

config LCZ_BT
	bool "Enable Bluetooth utility functions"

config LCZ_AD_FIND
	bool "Enable advertisement parser"

config LCZ_SENSOR_ADV_FORMAT
	bool "Enable BLE Sensor Advertisement Format Module"
	depends on LCZ_BT

config LCZ_SENSOR_EVENT
	bool "Enable sensor event module"

config LCZ_SENSOR_ADV_MATCH
	bool "Enable sensor advertisement matching module"

rsource "Kconfig.lcz_bt_scan"

endmenu

endif # BT
```

## ble_common/Kconfig.lcz_bt_scan
```kconfig
#
# Copyright (c) 2021 Laird Connectivity
#
# SPDX-License-Identifier: Apache-2.0
#

menuconfig LCZ_BT_SCAN
	bool "Enable scan module for multi-user system"

if LCZ_BT_SCAN

config LCZ_BT_SCAN_MAX_USERS
	int "Maximum number of users of the scan module"
	range 1 32
	default 2

config LCZ_BT_SCAN_VERBOSE_ADV_HANDLER
	bool "Enable Verbose logging of advertisements"

config LCZ_BT_SCAN_LOG_LEVEL
	int "Log level for Bluetooth Scan module"
	range 0 4
	default 3

config LCZ_BT_SCAN_DEFAULT_WINDOW
	int "Default amount of time to scan"
	range 16 16384
	default 48
	help
	  N * 0.625 ms
	  The default config is a 30 ms window and a 60 ms interval.
	  The system will attempt to scan 50% of the time.

config LCZ_BT_SCAN_DEFAULT_INTERVAL
	int "Default amount of time between scans"
	range 16 16384
	default 96
	help
	  N * 0.625 ms
	  The default config is a 30 ms window and a 60 ms interval.
	  The system will attempt to scan 50% of the time.

config LCZ_BT_SCAN_ALLOW_MULTIPLE_SCAN_PARAM_UPDATERS
	bool "Allow multiple users to update scan parameters"
	help
	  With multiple users the settings of one module might conflict
	  with settings required by another module.  Scan parameters may
	  need to be handled at the application level.

endif # LCZ_BT_SCAN
```

## ble_common/Kconfig.lcz_bt_security
```kconfig
#
# Copyright (c) 2021 Laird Connectivity
#
# SPDX-License-Identifier: Apache-2.0
#

menuconfig LCZ_BT_SECURITY
	bool "Enable Bluetooth security callback wrapper module"

if LCZ_BT_SECURITY

config LCZ_BT_SECURITY_INIT_PRIORITY
	int "Application level sys init priority"
	default 25

config LCZ_BT_SECURITY_MAX_USERS
	int "Maximum number of users of the module"
	range 1 32
	default 2

config LCZ_BT_SECURITY_HAS_DISPLAY
	bool "Set to true if device has a display for pairing info"
	help
		A display is required for MITM.

config LCZ_BT_SECURITY_HAS_KEYBOARD
	bool "Set to true if device has a keyboard for pairing info"
	help
		This must be true to be compatible with BT510.

config LCZ_BT_SECURITY_HAS_BUTTON
	bool "Set to true if device has passkey confirm button"
	help
		If has display and this are true,
		then passkey confirmation will be used.

config LCZ_BT_SECURITY_OOB_PAIRING
	bool "Enable the OOB data request callback"

config LCZ_BT_SECURITY_LOG_LEVEL
	int "Log level for Bluetooth Security module"
	range 0 4
	default 3

endif # LCZ_BT_SECURITY
```

## ble_services/Kconfig
```kconfig
#
# Copyright (c) 2020-2021 Laird Connectivity
#
# SPDX-License-Identifier: Apache-2.0
#

if BT && LCZ_BT

menu "Laird Connectivity Zephyr BLE Services"
	 default y

config SHA256_SIZE
	int
	default 32

config UNIVERSAL_BOOTLOADER_SERVICE
	bool "Enable Universal Bootloader Service"
	depends on LAIRDCONNECTIVITY_BLR

config BLE_CELLULAR_SERVICE
	bool "Enable BLE Cell service"

config BLE_POWER_SERVICE
	bool "Enable BLE Power Service"
	select LCZ_POWER

if BLE_POWER_SERVICE

config BLE_POWER_SERVICE_LOG_LEVEL
	int "BLE Power Service Log level"
	range 0 4
	default 3

endif

config BLE_ESS_SERVICE
	bool "Enable BLE ESS Service"

if BLE_ESS_SERVICE

config BLE_ESS_SERVICE_LOG_LEVEL
	int "BLE ESS Service Log level"
	range 0 4
	default 2

endif

config LCZ_BLE_DIS
	bool "Enable Custom Device Information BLE service"

config FOTA_SERVICE
	bool "Enable Firmware Update Over-the-Air Service"
	depends on FILE_SYSTEM_UTILITIES
	help
		This service can be used in conjunction with mcumgr file transfer to update
		the HL7800 modem.

if FOTA_SERVICE

config FOTA_HASH_SIZE
	int "Size of the hash in bytes"
	default SHA256_SIZE

config FOTA_FILE_NAME_MAX_SIZE
	int "Maximum file name length"
	default 64

config FOTA_FS_MOUNT
	string "Default mount for the file system used by FOTA"
	default "/lfs"

endif

endmenu

endif
```

## components/Kconfig
```kconfig
#
# Copyright (c) 2020-2022 Laird Connectivity
#
# SPDX-License-Identifier: Apache-2.0
#

menu "Laird Connectivity Zephyr Components"

config LCZ_DNS
	bool "Wrapper for DNS resolver that provides retries and debug printing"
	depends on DNS_RESOLVER
	depends on NET_SOCKETS

config DNS_RESOLVER_ADDR_MAX_SIZE
	int
	default 24 if NET_IPV6
	default 16

config DNS_RETRIES
    int "Number of times to retry resolving server address"
	depends on LCZ_DNS
    default 1

config DNS_RETRY_DELAY_SECONDS
    int "Number of seconds to wait between resolution attempts"
	depends on LCZ_DNS
    default 5

config LCZ_HWREV
	bool "Enable Hardware Revision ID detection"
	depends on (BOARD_BT510)
	help
		Enable Hardware Revision ID checking.

config LCZ_SOCK
	bool "Wrapper for single socket"
	depends on NET_SOCKETS
	depends on MBEDTLS_DTLS

config LCZ_SOCK_VERBOSE_POLL
	bool "Enable verbose logging for poll timeouts and wait complete"
	depends on LCZ_SOCK

config LCZ_SOCK_TIMING
	bool "Enable verbose logging for poll timeouts and wait complete"
	depends on LCZ_SOCK

config LCZ_RESET_ON_EXIT
	bool "Reset when exit is called"
	depends on REBOOT
	help
		Default Zephyr behavior is to wait forever.

config LCZ_SOFTWARE_RESET
	bool "Enable software reset module (wraps Zephyr reset with a delay)"
	depends on REBOOT

config LCZ_SOFTWARE_RESET_LOG_LEVEL
    int "Software Reset module log level"
	depends on LCZ_SOFTWARE_RESET
    range 0 4
    default 3

config LCZ_SOFTWARE_RESET_AFTER_ASSERT_USES_MEMFAULT
    bool "Software reset after assert calls Memfault assert"
	depends on LCZ_SOFTWARE_RESET
	depends on LCZ_MEMFAULT
	help
	  If enabled and a debugger is connected, the system will halt.
	  This may not be desired when logging using RTT.

rsource "Kconfig.lcz_nfc"
rsource "Kconfig.lcz_qrtc"
rsource "Kconfig.lcz_param_file"
rsource "Kconfig.lcz_led"
rsource "Kconfig.lcz_pwm_led"
rsource "Kconfig.lcz_no_init_ram_var"
rsource "Kconfig.lcz_event_manager"
rsource "Kconfig.lcz_bracket"
rsource "Kconfig.lcz_approtect"
rsource "Kconfig.lcz_rpmsg"
rsource "Kconfig.lcz_watchdog"
rsource "Kconfig.lcz_shell_log"
rsource "Kconfig.dummy_smp"
rsource "Kconfig.lcz_ramdisk"

endmenu
```

## components/Kconfig.dummy_smp
```kconfig
# Copyright (c) 2014-2015 Wind River Systems, Inc.
# Copyright (c) 2016 Cadence Design Systems, Inc.
# Copyright (c) 2021-2022 Laird Connectivity
# SPDX-License-Identifier: Apache-2.0

menuconfig DUMMY_SMP
	bool "Enable dummy SMP component"
	depends on MCUMGR
	help
	  Enables the dummy SMP component which can be used for unit
	  testing SMP functionality without needing a real interface.

if DUMMY_SMP

config DUMMY_SMP_RX_BUF_SIZE
	int "Size of receive buffer for mcumgr fragments received via dummy interface, in bytes"
	default 128
	help
	  Specifies the size of the mcumgr dummy interface receive
	  buffer, in bytes. This value must be large enough to
	  accommodate any line sent by an mcumgr client.

endif # DUMMY_SMP
```

## components/Kconfig.lcz_approtect
```kconfig
#
# Copyright (c) 2021 Laird Connectivity
#
# SPDX-License-Identifier: Apache-2.0
#

menuconfig LCZ_APPROTECT
    bool "Enable the APPROTECT enablement feature"
    help
        A user application can call the functions to enable readback
        protection or CPU debug protection on supported silicon, which
        will enable it and optionally reboot the module if it is not
        currently enabled

if LCZ_APPROTECT

module=LCZ_APPROTECT
module-str=LCZ_APPROTECT
source "subsys/logging/Kconfig.template.log_config"

menuconfig LCZ_APPROTECT_STARTUP
    bool "Enabling start-up readback protection/CPU debug protection"
    help
        At start-up, before the kernel initiates, a task will be ran to
        enable the requested features which will then reboot the module
        to apply those settings

if LCZ_APPROTECT_STARTUP

config LCZ_APPROTECT_STARTUP_INIT_LEVEL
    int "Init Level"
    range 0 4
    default 0
    help
      0 - PRE_KERNEL_1
      1 - PRE_KERNEL_2
      2 - POST_KERNEL
      3 - APPLICATION
      4 - SMP

config LCZ_APPROTECT_STARTUP_INIT_PRIORITY
    int "Init priority"
    default 0

config LCZ_APPROTECT_STARTUP_READBACK_PROTECTION
    bool "Start-up readback protection enablement"
    default y

config LCZ_APPROTECT_STARTUP_CPU_DEBUG_PROTECTION
    bool "Start-up CPU debug protection enablement"
    default y

endif

endif # LCZ_APPROTECT
```

## components/Kconfig.lcz_bracket
```kconfig
#
# Copyright (c) 2021 Laird Connectivity
#
# SPDX-License-Identifier: Apache-2.0
#

config LCZ_BRACKET
	bool "Enable JSON bracket handler {} module"

config LCZ_BRACKET_INTERCEPTS_ESCAPED_FORWARD_SLASH
	bool "Bracket handler replaces '\/' with '/'"
	depends on LCZ_BRACKET
	default y
	help
		iOS escapes '/' with "\/"
		If this is intercepted by the bracket handler, then the buffer
		sizes don't need to be doubled to handle a base-64 encoded
		image.

config LOG_LEVEL_LCZ_BRACKET
    int "Log level for bracket module"
    range 0 4
    default 1
```

## components/Kconfig.lcz_event_manager
```kconfig
#
# Copyright (c) 2021 Laird Connectivity
#
# SPDX-License-Identifier: Apache-2.0
#

menuconfig LCZ_EVENT_MANAGER
	bool "Enables Event Manager"
	depends on FILE_SYSTEM
	depends on FILE_SYSTEM_UTILITIES
	depends on LCZ_QRTC
	depends on LCZ

if LCZ_EVENT_MANAGER

config LCZ_EVENT_MANAGER_EVENTS_PER_FILE
	int "The number of events to store in each file."
	range 1 1000
	default 100

config LCZ_EVENT_MANAGER_NUMBER_OF_FILES
	int "The number of files for the Event Manager to store."
	range 1 10
	default 1

config LCZ_EVENT_MANAGER_BACKGROUND_THREAD_PRIORITY
	int "The priority of the Event Manager background thread."
	depends on COOP_ENABLED
	default -1
	help
		Needs to be cooperative to ensure tasks are completed as quickly as possible.

config LCZ_EVENT_MANAGER_BACKGROUND_THREAD_UPDATE_RATE
	int "The number of milliseconds between updates of the Event Manager background thread."
	range 500 10000
	default 1000

config LCZ_EVENT_MANAGER_BACKGROUND_THREAD_STACK_SIZE
	int "The number of bytes used by the Event Manager background thread stack."
	range 1024 4096
	default 1024

config LCZ_EVENT_MANAGER_FILE_HANDLER_PRIVATE_DIRECTORY
	string "The file system location where private data files are stored."
	default "/ext/"

config LCZ_EVENT_MANAGER_FILE_HANDLER_PUBLIC_DIRECTORY
	string "The file system location where public output log files are stored." 
	default "/ext/"

config LCZ_EVENT_MANAGER_FILE_HANDLER_QUEUE_SIZE
	int "The size of the message queue used to store incoming events."
	range 10 100
	default 16

config LCZ_EVENT_MANAGER_FILE_HANDLER_THREAD_STACK_SIZE
	int "The size of the stack used by the workqueue thread that saves event files."
	range 1024 4096
	default 1024

config LCZ_EVENT_MANAGER_FILE_HANDLER_THREAD_PRIORITY
	int "The priority of the thread used to save event files."
	depends on PREEMPT_ENABLED
	default 1
	help
		Needs to be pre-emptible to avoid blocking higher priority tasks due to potential long update times.

endif # LCZ_EVENT_MANAGER
```

## components/Kconfig.lcz_led
```kconfig
#
# Copyright (c) 2020 Laird Connectivity
#
# SPDX-License-Identifier: Apache-2.0
#

menuconfig LCZ_LED
	bool "Enable the LED component"
	help
		Simple on/off and pattern control for multiple LEDs.

if LCZ_LED

config LCZ_LED_LOG_LEVEL
    int "Log level for LED Module"
    range 0 4
    default 3

config LCZ_LED_CUSTOM_ON_OFF
	bool "Allow custom on/off functions"
	help
		When this is selected the LED driver will not initialize pins.

config DEFAULT_LED_ON_TIME_FOR_1_SECOND_BLINK
	int "On time in milliseconds"
	range 1 999
	default 100

config DEFAULT_LED_OFF_TIME_FOR_1_SECOND_BLINK
	int "Off time in milliseconds"
	range 1 999
	default 900

config LCZ_NUMBER_OF_LEDS
	int "Number of LEDS"
	default 4
	range 1 31

endif # LCZ_LED
```

## components/Kconfig.lcz_nfc
```kconfig
#
# Copyright (c) 2022 Laird Connectivity
#
# SPDX-License-Identifier: Apache-2.0
#

config LCZ_NFC
	bool "Enables NFC Support"
	select NFC_T2T_NRFXLIB
	select NFC_NDEF
	select NFC_NDEF_MSG
	select NFC_NDEF_RECORD
	select NFC_NDEF_LE_OOB_REC
	select NFC_NDEF_LE_OOB_REC_PARSER
	select NFC_NDEF_TEXT_RECORD
	select NFC_NDEF_URI_MSG
	select NFC_NDEF_URI_REC
	select NFC_NDEF_PARSER
	select NFC_NDEF_PAYLOAD_TYPE_COMMON
	select NFC_NDEF_TNEP_RECORD

if LCZ_NFC

config LCZ_NFC_REC1_STR
	string "NFC Record 1 String"
	default "https://apps.apple.com/us/app/laird-pinnacle-connect/id1481075861?ls=1"

config LCZ_NFC_REC2_STR
	string "NFC Record 2 String"
	default "http://play.google.com/store/apps/details?id=com.lairdconnect.pinnacle.connect"

endif # LCZ_NFC
```

## components/Kconfig.lcz_no_init_ram_var
```kconfig
#
# Copyright (c) 2020 Laird Connectivity
#
# SPDX-License-Identifier: Apache-2.0
#

menuconfig LCZ_NO_INIT_RAM_VAR
    bool "Enable non-initialized RAM variable module"

if LCZ_NO_INIT_RAM_VAR

config LCZ_NO_INIT_RAM_VAR_VALID_KEY
    hex "Key used for determining if data is valid"
    default 0xc0de1eaf

endif # LCZ_NO_INIT_RAM_VAR
```

## components/Kconfig.lcz_param_file
```kconfig
#
# Copyright (c) 2021 Laird Connectivity
#
# SPDX-License-Identifier: Apache-2.0
#

menuconfig LCZ_PARAM_FILE
    bool "Enable Laird Connectivity Parameter File Module"
    depends on FILE_SYSTEM
    depends on FILE_SYSTEM_UTILITIES
    depends on HEAP_MEM_POOL_SIZE > 0

if LCZ_PARAM_FILE

config LCZ_PARAM_FILE_INIT_PRIORITY
    int "Priority of LCZ parameter module initialization (APPLICATION)"
    range 1 99
    default 1
    help
        Can't be higher than the file system init priority.
        If LFS is used, then it must be lower than its priority (POST_KERNEL, 99).

config LCZ_PARAM_FILE_LOG_LEVEL
    int "Log level for Parameters Module"
    range 0 4
    default 3

config LCZ_PARAM_FILE_LOG_VERBOSE
    bool "Enable verbose debug logging for Parameters Module"
    depends on LCZ_PARAM_FILE_LOG_LEVEL = 4

config LCZ_PARAM_FILE_MOUNT_POINT
    string "File system mount point for Laird Connectivity parameters"
    default "/lfs"

config LCZ_PARAM_FILE_PATH
    string "Folder (partial path) for parameters"
    default ""
    help
        The default location for parameters written by the cloud is
        "/lfs/params.txt".

config LCZ_PARAM_FILE_MAX_FILE_LENGTH
    int "Maximum length of the parameter file"
    default 1000
    help
        This should be set by the code generator.

config LCZ_PARAM_FILE_MAX_VALUE_LENGTH
    int "Maximum value of a parameter in hex/string form"
    default 96
    help
        This should be set by the code generator.

config LCZ_PARAM_FILE_4_DIGIT_ID
    bool "Generate all 4 digits of parameter ID for backward compatibility"

config LCZ_PARAM_FILE_SHELL
	bool "Enable parameters shell"

endif # LCZ_PARAM_FILE
```
